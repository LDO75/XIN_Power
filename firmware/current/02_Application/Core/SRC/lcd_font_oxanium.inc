/*
 * Oxanium 嵌入式 4bpp 抗锯齿字模。
 * Copyright 2019 The Oxanium Project Authors.
 * 本衍生字模依据 SIL Open Font License 1.1 分发；完整许可见
 * ThirdParty/Oxanium/OFL.txt。
 * 本文件由 Tools/generate_oxanium_font.py 自动生成，请勿手工修改。
 */

static const char s_oxanium_small_characters[] = " !%()+-./0123456789:?ABCDEFGHIJKLMNOPQRSTUVWXYZ^";

static const LCD_FontGlyph_t s_oxanium_small_glyphs[] =
{
  {3U, 0U, 0, 11, 5U, 0U, 0U}, /* 0x20 ' ' */
  {3U, 10U, 0, 1, 5U, 0U, 15U}, /* 0x21 '!' */
  {12U, 10U, 0, 1, 13U, 15U, 60U}, /* 0x25 '%' */
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  {7U, 10U, 0, 1, 9U, 1744U, 35U}, /* 0x5E '^' */
};

static const uint8_t s_oxanium_small_bitmap[] =
{
  0x0EU, 0x60U, 0xE6U, 0x0EU, 0x60U, 0xE6U, 0x0EU, 0x60U, 0xE6U, 0x0EU, 0x60U, 0x00U, 0x0FU, 0x70U, 0xF7U, 0x3DU,
  0xECU, 0x00U, 0x09U, 0x40U, 0x00U, 0x78U, 0x0CU, 0x30U, 0x1EU, 0x20U, 0x00U, 0x88U, 0x0CU, 0x30U, 0x8AU, 0x00U,
  0x00U, 0x88U, 0x0CU, 0x31U, 0xE3U, 0x00U, 0x00U, 0x78U, 0x0CU, 0x36U, 0xB3U, 0xDEU, 0xC0U, 0x3DU, 0xECU, 0x1DU,
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  0x00U, 0x00U, 0x00U,
};

static const LCD_Font_t s_oxanium_small_font =
{
  s_oxanium_small_characters,
  s_oxanium_small_glyphs,
  s_oxanium_small_bitmap,
  48U,
  14U,
  1U
};

static const char s_oxanium_medium_characters[] = " !%+-./0123456789:?ABCDEFGHIJKLMNOPQRSTUVWXYZ";

static const LCD_FontGlyph_t s_oxanium_medium_glyphs[] =
{
  {4U, 0U, 0, 13, 5U, 0U, 0U}, /* 0x20 ' ' */
  {4U, 12U, 0, 1, 6U, 0U, 24U}, /* 0x21 '!' */
  {14U, 12U, 0, 1, 15U, 24U, 84U}, /* 0x25 '%' */
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  {10U, 12U, 0, 1, 11U, 2389U, 60U}, /* 0x5A 'Z' */
};

static const uint8_t s_oxanium_medium_bitmap[] =
{
  0x0AU, 0xE0U, 0x0AU, 0xE0U, 0x0AU, 0xE0U, 0x0AU, 0xE0U, 0x0AU, 0xE0U, 0x0AU, 0xE0U, 0x0AU, 0xE0U, 0x0AU, 0xE0U,
  0x0AU, 0xE0U, 0x00U, 0x00U, 0x0CU, 0xF0U, 0x0CU, 0xF0U, 0x1CU, 0xFFU, 0xA0U, 0x00U, 0x1CU, 0x20U, 0x00U, 0x5EU,
  0x23U, 0xF2U, 0x00U, 0x7EU, 0x10U, 0x00U, 0x6DU, 0x01U, 0xF3U, 0x01U, 0xE7U, 0x00U, 0x00U, 0x6DU, 0x01U, 0xF3U,
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  0xD0U,
};

static const LCD_Font_t s_oxanium_medium_font =
{
  s_oxanium_medium_characters,
  s_oxanium_medium_glyphs,
  s_oxanium_medium_bitmap,
  45U,
  17U,
  1U
};

static const char s_oxanium_large_characters[] = " +-.0123456789?AV";

static const LCD_FontGlyph_t s_oxanium_large_glyphs[] =
{
  {8U, 0U, 0, 26, 9U, 0U, 0U}, /* 0x20 ' ' */
  {19U, 19U, 0, 7, 20U, 0U, 181U}, /* 0x2B '+' */
  {12U, 12U, 0, 14, 13U, 181U, 72U}, /* 0x2D '-' */
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  {21U, 22U, 0, 4, 22U, 2784U, 231U}, /* 0x56 'V' */
};

static const uint8_t s_oxanium_large_bitmap[] =
{
  0x00U, 0x00U, 0x00U, 0x07U, 0xFFU, 0xE0U, 0x00U, 0x00U, 0x00U, 0x00U, 0x00U, 0x00U, 0x00U, 0x7FU, 0xFEU, 0x00U,
  0x00U, 0x00U, 0x00U, 0x00U, 0x00U, 0x00U, 0x07U, 0xFFU, 0xE0U, 0x00U, 0x00U, 0x00U, 0x00U, 0x00U, 0x00U, 0x00U,
  0x7FU, 0xFEU, 0x00U, 0x00U, 0x00U, 0x00U, 0x00U, 0x00U, 0x00U, 0x07U, 0xFFU, 0xE0U, 0x00U, 0x00U, 0x00U, 0x00U,
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  0xFFU, 0xFFU, 0xFFU, 0x90U, 0x00U, 0x00U, 0x00U,
};

static const LCD_Font_t s_oxanium_large_font =
{
  s_oxanium_large_characters,
  s_oxanium_large_glyphs,
  s_oxanium_large_bitmap,
  17U,
  33U,
  1U
};

static const char s_oxanium_value_characters[] = " +-.0123456789?AV";

static const LCD_FontGlyph_t s_oxanium_value_glyphs[] =
{
  {9U, 0U, 0, 29, 10U, 0U, 0U}, /* 0x20 ' ' */
  {21U, 21U, 0, 8, 22U, 0U, 221U}, /* 0x2B '+' */
  {13U, 13U, 0, 16, 15U, 221U, 85U}, /* 0x2D '-' */
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  {23U, 25U, 0, 4, 25U, 3499U, 288U}, /* 0x56 'V' */
};

static const uint8_t s_oxanium_value_bitmap[] =
{
  0x00U, 0x00U, 0x00U, 0x00U, 0x8FU, 0xFFU, 0x50U, 0x00U, 0x00U, 0x00U, 0x00U, 0x00U, 0x00U, 0x00U, 0x08U, 0xFFU,
  0xF5U, 0x00U, 0x00U, 0x00U, 0x00U, 0x00U, 0x00U, 0x00U, 0x00U, 0x8FU, 0xFFU, 0x50U, 0x00U, 0x00U, 0x00U, 0x00U,
  0x00U, 0x00U, 0x00U, 0x08U, 0xFFU, 0xF5U, 0x00U, 0x00U, 0x00U, 0x00U, 0x00U, 0x00U, 0x00U, 0x00U, 0x8FU, 0xFFU,
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  0x00U, 0x00U, 0x02U, 0xFFU, 0xFFU, 0xFFU, 0xF4U, 0x00U, 0x00U, 0x00U, 0x00U,
};

static const LCD_Font_t s_oxanium_value_font =
{
  s_oxanium_value_characters,
  s_oxanium_value_glyphs,
  s_oxanium_value_bitmap,
  17U,
  37U,
  1U
};
