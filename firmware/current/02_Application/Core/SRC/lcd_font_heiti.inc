/* XIN UI Heiti bitmap subset, derived from Source Han Sans SC.
 * Copyright 2014-2025 Adobe. Derived bitmap: XIN Power contributors.
 * SIL Open Font License 1.1; see ThirdParty/SourceHanSans/OFL.txt.
 * Generated by Tools/generate_heiti_font.py; packed 1bpp. */
static const LCD_HeitiGlyph_t s_heiti_14[]={{0x0020U,3U,0U},{0x0021U,5U,14U},{0x0022U,7U,28U},{0x0023U,8U,42U},{0x0024U,8U,56U},{0x0025U,13U,70U},{0x0026U,10U,98U},{0x0027U,4U,126U},{0x0028U,5U,140U},{0x0029U,5U,154U},{0x002AU,7U,168U},{0x002BU,8U,182U},{0x002CU,4U,196U},{0x002DU,5U,210U},{0x002EU,4U,224U},{0x002FU,5U,238U},{0x0030U,8U,252U},{0x0031U,8U,266U},{0x0032U,8U,280U},{0x0033U,8U,294U},{0x0034U,8U,308U},{0x0035U,8U,322U},{0x0036U,8U,336U},{0x0037U,8U,350U},{0x0038U,8U,364U},{0x0039U,8U,378U},{0x003AU,4U,392U},{0x003BU,4U,406U},{0x003CU,8U,420U},{0x003DU,8U,434U},{0x003EU,8U,448U},{0x003FU,7U,462U},{0x0040U,13U,476U},{0x0041U,9U,504U},{0x0042U,9U,532U},{0x0043U,9U,560U},{0x0044U,10U,588U},{0x0045U,8U,616U},{0x0046U,8U,630U},{0x0047U,10U,644U},{0x0048U,10U,672U},{0x0049U,4U,700U},{0x004AU,7U,714U},{0x004BU,9U,728U},{0x004CU,8U,756U},{0x004DU,11U,770U},{0x004EU,10U,798U},{0x004FU,10U,826U},{0x0050U,9U,854U},{0x0051U,10U,882U},{0x0052U,9U,910U},{0x0053U,8U,938U},{0x0054U,8U,952U},{0x0055U,10U,966U},{0x0056U,8U,994U},{0x0057U,12U,1008U},{0x0058U,8U,1036U},{0x0059U,7U,1050U},{0x005AU,8U,1064U},{0x005BU,5U,1078U},{0x005CU,5U,1092U},{0x005DU,5U,1106U},{0x005EU,8U,1120U},{0x005FU,8U,1134U},{0x0060U,8U,1148U},{0x0061U,8U,1162U},{0x0062U,9U,1176U},{0x0063U,7U,1204U},{0x0064U,9U,1218U},{0x0065U,8U,1246U},{0x0066U,5U,1260U},{0x0067U,8U,1274U},{0x0068U,9U,1288U},{0x0069U,4U,1316U},{0x006AU,4U,1330U},{0x006BU,8U,1344U},{0x006CU,4U,1358U},{0x006DU,13U,1372U},{0x006EU,9U,1400U},{0x006FU,8U,1428U},{0x0070U,9U,1442U},{0x0071U,9U,1470U},{0x0072U,5U,1498U},{0x0073U,7U,1512U},{0x0074U,5U,1526U},{0x0075U,9U,1540U},{0x0076U,7U,1568U},{0x0077U,11U,1582U},{0x0078U,7U,1610U},{0x0079U,7U,1624U},{0x007AU,7U,1638U},{0x007BU,5U,1652U},{0x007CU,4U,1666U},{0x007DU,5U,1680U},{0x007EU,8U,1694U},{0x4E0EU,14U,1708U},{0x4E2DU,14U,1736U},{0x4EAEU,14U,1764U},{0x4EF6U,14U,1792U},{0x4F11U,14U,1820U},{0x4FDDU,14U,1848U},{0x5012U,14U,1876U},{0x5148U,14U,1904U},{0x5173U,14U,1932U},{0x51C6U,14U,1960U},{0x51FAU,14U,1988U},{0x5206U,14U,2016U},{0x52A8U,14U,2044U},{0x540CU,14U,2072U},{0x5411U,14U,2100U},{0x542FU,14U,2128U},{0x5524U,14U,2156U},{0x5668U,14U,2184U},{0x56DEU,14U,2212U},{0x56FAU,14U,2240U},{0x58F0U,14U,2268U},{0x5931U,14U,2296U},{0x59CBU,14U,2324U},{0x5B58U,14U,2352U},{0x5C4FU,14U,2380U},{0x5DE6U,14U,2408U},{0x5DF2U,14U,2436U},{0x5E55U,14U,2464U},{0x5E76U,14U,2492U},{0x5EA6U,14U,2520U},{0x5F00U,14U,2548U},{0x6301U,14U,2576U},{0x6478U,14U,2604U},{0x65ADU,14U,2632U},{0x65B9U,14U,2660U},{0x663EU,14U,2688U},{0x672CU,14U,2716U},{0x6821U,14U,2744U},{0x6B63U,14U,2772U},{0x6B65U,14U,2800U},{0x6CE2U,14U,2828U},{0x6D41U,14U,2856U},{0x6E90U,14U,2884U},{0x6ED1U,14U,2912U},{0x70B9U,14U,2940U},{0x7248U,14U,2968U},{0x7535U,14U,2996U},{0x7720U,14U,3024U},{0x786CU,14U,3052U},{0x793AU,14U,3080U},{0x79D2U,14U,3108U},{0x7F6EU,14U,3136U},{0x8702U,14U,3164U},{0x89E6U,14U,3192U},{0x8BBEU,14U,3220U},{0x8D1FU,14U,3248U},{0x8D25U,14U,3276U},{0x8F7DU,14U,3304U},{0x8F93U,14U,3332U},{0x8FD4U,14U,3360U},{0x9192U,14U,3388U},{0x91C7U,14U,3416U},{0x949FU,14U,3444U},{0x95EDU,14U,3472U},{0x96C6U,14U,3500U},{0x96F6U,14U,3528U},{0x97F3U,14U,3556U},{0x9E23U,14U,3584U}};
static const uint8_t s_heiti_bits_14[]={0,0,0,0,0,0,0,0,0,0,0,0,0,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0,0};
static const LCD_HeitiGlyph_t s_heiti_18[]={{0x0020U,4U,0U},{0x0021U,6U,18U},{0x0022U,9U,36U},{0x0023U,10U,72U},{0x0024U,10U,108U},{0x0025U,17U,144U},{0x0026U,12U,198U},{0x0027U,5U,234U},{0x0028U,6U,252U},{0x0029U,6U,270U},{0x002AU,8U,288U},{0x002BU,10U,306U},{0x002CU,5U,342U},{0x002DU,6U,360U},{0x002EU,5U,378U},{0x002FU,7U,396U},{0x0030U,10U,414U},{0x0031U,10U,450U},{0x0032U,10U,486U},{0x0033U,10U,522U},{0x0034U,10U,558U},{0x0035U,10U,594U},{0x0036U,10U,630U},{0x0037U,10U,666U},{0x0038U,10U,702U},{0x0039U,10U,738U},{0x003AU,5U,774U},{0x003BU,5U,792U},{0x003CU,10U,810U},{0x003DU,10U,846U},{0x003EU,10U,882U},{0x003FU,9U,918U},{0x0040U,17U,954U},{0x0041U,11U,1008U},{0x0042U,12U,1044U},{0x0043U,11U,1080U},{0x0044U,12U,1116U},{0x0045U,11U,1152U},{0x0046U,10U,1188U},{0x0047U,12U,1224U},{0x0048U,13U,1260U},{0x0049U,5U,1296U},{0x004AU,10U,1314U},{0x004BU,12U,1350U},{0x004CU,10U,1386U},{0x004DU,15U,1422U},{0x004EU,13U,1458U},{0x004FU,13U,1494U},{0x0050U,11U,1530U},{0x0051U,13U,1566U},{0x0052U,11U,1602U},{0x0053U,11U,1638U},{0x0054U,11U,1674U},{0x0055U,13U,1710U},{0x0056U,10U,1746U},{0x0057U,16U,1782U},{0x0058U,10U,1818U},{0x0059U,10U,1854U},{0x005AU,11U,1890U},{0x005BU,6U,1926U},{0x005CU,7U,1944U},{0x005DU,6U,1962U},{0x005EU,10U,1980U},{0x005FU,10U,2016U},{0x0060U,11U,2052U},{0x0061U,10U,2088U},{0x0062U,11U,2124U},{0x0063U,9U,2160U},{0x0064U,11U,2196U},{0x0065U,10U,2232U},{0x0066U,6U,2268U},{0x0067U,10U,2286U},{0x0068U,11U,2322U},{0x0069U,5U,2358U},{0x006AU,5U,2376U},{0x006BU,10U,2394U},{0x006CU,5U,2430U},{0x006DU,17U,2448U},{0x006EU,11U,2502U},{0x006FU,11U,2538U},{0x0070U,11U,2574U},{0x0071U,11U,2610U},{0x0072U,7U,2646U},{0x0073U,8U,2664U},{0x0074U,7U,2682U},{0x0075U,11U,2700U},{0x0076U,9U,2736U},{0x0077U,14U,2772U},{0x0078U,9U,2808U},{0x0079U,9U,2844U},{0x007AU,9U,2880U},{0x007BU,6U,2916U},{0x007CU,5U,2934U},{0x007DU,6U,2952U},{0x007EU,10U,2970U},{0x4E0EU,18U,3006U},{0x4E2DU,18U,3060U},{0x4EAEU,18U,3114U},{0x4EF6U,18U,3168U},{0x4F11U,18U,3222U},{0x4FDDU,18U,3276U},{0x5012U,18U,3330U},{0x5148U,18U,3384U},{0x5173U,18U,3438U},{0x51C6U,18U,3492U},{0x51FAU,18U,3546U},{0x5206U,18U,3600U},{0x52A8U,18U,3654U},{0x540CU,18U,3708U},{0x5411U,18U,3762U},{0x542FU,18U,3816U},{0x5524U,18U,3870U},{0x5668U,18U,3924U},{0x56DEU,18U,3978U},{0x56FAU,18U,4032U},{0x58F0U,18U,4086U},{0x5931U,18U,4140U},{0x59CBU,18U,4194U},{0x5B58U,18U,4248U},{0x5C4FU,18U,4302U},{0x5DE6U,18U,4356U},{0x5DF2U,18U,4410U},{0x5E55U,18U,4464U},{0x5E76U,18U,4518U},{0x5EA6U,18U,4572U},{0x5F00U,18U,4626U},{0x6301U,18U,4680U},{0x6478U,18U,4734U},{0x65ADU,18U,4788U},{0x65B9U,18U,4842U},{0x663EU,18U,4896U},{0x672CU,18U,4950U},{0x6821U,18U,5004U},{0x6B63U,18U,5058U},{0x6B65U,18U,5112U},{0x6CE2U,18U,5166U},{0x6D41U,18U,5220U},{0x6E90U,18U,5274U},{0x6ED1U,18U,5328U},{0x70B9U,18U,5382U},{0x7248U,18U,5436U},{0x7535U,18U,5490U},{0x7720U,18U,5544U},{0x786CU,18U,5598U},{0x793AU,18U,5652U},{0x79D2U,18U,5706U},{0x7F6EU,18U,5760U},{0x8702U,18U,5814U},{0x89E6U,18U,5868U},{0x8BBEU,18U,5922U},{0x8D1FU,18U,5976U},{0x8D25U,18U,6030U},{0x8F7DU,18U,6084U},{0x8F93U,18U,6138U},{0x8FD4U,18U,6192U},{0x9192U,18U,6246U},{0x91C7U,18U,6300U},{0x949FU,18U,6354U},{0x95EDU,18U,6408U},{0x96C6U,18U,6462U},{0x96F6U,18U,6516U},{0x97F3U,18U,6570U},{0x9E23U,18U,6624U}};
static const uint8_t s_heiti_bits_18[]={0,0,0,0,0,0,0,0,0,0,0,0,0,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0,0};
